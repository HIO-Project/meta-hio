## conf/layer.conf
```bitbake
# We have a conf and classes directory, add to BBPATH
#BBPATH .= ":${LAYERDIR}"
#BBPATH := "${BBPATH}:${LAYERDIR}"
BBPATH .= ":${LAYERDIR}"

# We have recipes-* directories, add to BBFILES
BBFILES += "${LAYERDIR}/recipes-*/*/*.bb \
	${LAYERDIR}/recipes-*/*/*.bbappend"


BBFILE_COLLECTIONS += "hio"
BBFILE_PATTERN_hio := "^${LAYERDIR}/"
BBFILE_PRIORITY_hio = "3"

#LAYERDEPENDS_hio = "core fsl-arm fsl-arm-extra"
LAYERDEPENDS_hio = "core fsl-arm"
```

## conf/machine/hio-board-dl.conf
```bitbake
#@TYPE: Machine
#@NAME: hio mx6
#@SOC: i.MX6DL
#@DESCRIPTION: Machine configuration for habey hio board

include conf/machine/include/imx-base.inc
include conf/machine/include/tune-cortexa9.inc

SOC_FAMILY = "mx6:mx6qi:mx6dl"

# Use u-boot imx
UBOOT_SUFFIX = "bin"
UBOOT_PADDING = "2"
#PREFERRED_PROVIDER_u-boot = "u-boot-imx"
#PREFERRED_VERSION_u-boot-imx = "2009.08"
PREFERRED_PROVIDER_u-boot = "u-boot-fslc"
PREFERRED_VERSION_u-boot-fslc = "2014.01"


PREFERRED_PROVIDER_virtual/kernel ?= "linux-imx"
PREFERRED_VERSION_linux-imx ?= "3.10.17"

#UBOOT_MACHINE = "mx6dl_sabresd_config"
UBOOT_MACHINE = "mx6dlsabresd_config"

SERIAL_CONSOLE = "115200 ttymxc1"

MACHINE_FEATURES += " pci bluetooh"
```

## conf/machine/hio-imx6dl-board.conf
```bitbake
#@TYPE: Machine
#@NAME: hio mx6
#@SOC: i.MX6DL
#@DESCRIPTION: Machine configuration for habey hio board

include conf/machine/include/imx-base.inc
include conf/machine/include/tune-cortexa9.inc

SOC_FAMILY = "mx6:mx6dl"

#UBOOT_SUFFIX = "imx"
#UBOOT_PADDING = "2"
PREFERRED_PROVIDER_u-boot = "u-boot-hio-imx6"
PREFERRED_VERSION_u-boot-hio-imx6 = "2015.04"

#kernel
KERNEL_DEVICETREE = "hio-imx6dl-board.dtb"
KERNEL_IMAGETYPE = "zImage"
PREFERRED_PROVIDER_virtual/kernel ?= "linux-hio-imx6"
PREFERRED_VERSION_linux-hio-imx6 ?= "3.14.52"

UBOOT_MACHINE = "hio-imx6dl-board_config"
SERIAL_CONSOLE = "115200 ttymxc1"

MACHINE_FEATURES += " pci bluetooh"
```

## conf/machine/hio-imx6dl-poe.conf
```bitbake
#@TYPE: Machine
#@NAME: hio mx6
#@SOC: i.MX6DL
#@DESCRIPTION: Machine configuration for habey hio board

include conf/machine/include/imx-base.inc
include conf/machine/include/tune-cortexa9.inc

SOC_FAMILY = "mx6:mx6dl"

# Use u-boot imx
#UBOOT_SUFFIX = "imx"
#UBOOT_PADDING = "2"
PREFERRED_PROVIDER_u-boot = "u-boot-hio-imx6"
PREFERRED_VERSION_u-boot-hio-imx6 = "2014.01"

#kernel
KERNEL_DEVICETREE = "hio-imx6dl-poe.dtb"
KERNEL_IMAGETYPE = "uImage"
PREFERRED_PROVIDER_virtual/kernel ?= "linux-hio-imx6"
PREFERRED_VERSION_linux-hio-imx6 ?= "3.10.17"

UBOOT_MACHINE = "hio-imx6dl-poe_config"
SERIAL_CONSOLE = "115200 ttymxc1"

MACHINE_FEATURES += " pci bluetooh"
```

## conf/machine/hio-nano-dl.conf
```bitbake
#@TYPE: Machine
#@NAME: hio mx6
#@SOC: i.MX6DL
#@DESCRIPTION: Machine configuration for habey hio board

include conf/machine/include/imx-base.inc
include conf/machine/include/tune-cortexa9.inc

SOC_FAMILY = "mx6:mx6q:mx6dl"

# Use u-boot imx
PREFERRED_PROVIDER_u-boot = "u-boot-fslc-nano-q"
#PREFERRED_VERSION_u-boot-fslc-nano-q = "2014.07"
#PREFERRED_PROVIDER_virtual/bootloader ?= "u-boot-fslc-nano-q"

#kernel
#PREFERRED_PROVIDER_virtual/kernel ?= "linux-imx"
KERNEL_DEVICETREE = "imx6dl-sabresd.dtb"
KERNEL_IMAGETYPE = "uImage"
PREFERRED_PROVIDER_virtual/kernel = "linux-nano"
PREFERRED_VERSION_linux-nano ?= "1.00"
#PREFERRED_PROVIDER_virtual/kernel ?= "linux-imx"
#PREFERRED_VERSION_linux-imx ?= "1.00"

UBOOT_MACHINE = "mx6dlsabresd_config"

SERIAL_CONSOLE = "115200 ttymxc0"
MACHINE_FEATURES += " pci bluetooh"

#add alsa-state
IMAGE_INSTALL_append = " alsa-state "
```

## conf/machine/hio-nano-q.conf
```bitbake
#@TYPE: Machine
#@NAME: hio mx6
#@SOC: i.MX6DL
#@DESCRIPTION: Machine configuration for habey hio board

include conf/machine/include/imx-base.inc
include conf/machine/include/tune-cortexa9.inc

SOC_FAMILY = "mx6:mx6qi:mx6dl"

# Use u-boot imx
UBOOT_SUFFIX = "bin"
UBOOT_PADDING = "2"
EFERRED_PROVIDER_u-boot = "u-boot-fslc-nano-q"
PREFERRED_VERSION_u-boot-fslc-nano-q = "2014.07"
PREFERRED_PROVIDER_virtual/bootloader ?= "u-boot-fslc-nano-q"

#kernel
PREFERRED_PROVIDER_virtual/kernel ?= "linux-imx"
PREFERRED_VERSION_linux-imx ?= "3.10.17"

UBOOT_MACHINE = "mx6qsabresd_config"

SERIAL_CONSOLE = "115200 ttymxc0"
MACHINE_FEATURES += " pci bluetooh"
```
